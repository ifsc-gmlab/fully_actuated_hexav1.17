## src/drivers/actuators/hx30hm_arm/Kconfig
```kconfig
menuconfig DRIVERS_ACTUATORS_HX30HM_ARM
	bool "HX-30HM serial robotic arm"
	default n
	help
		Enable the three-axis HX-30HM serial bus arm driver.
```

## src/modules/flying_car/Kconfig
```kconfig
menuconfig MODULES_FLYING_CAR
	bool "Flying-car runtime and isolated motor gate"
	default n
	---help---
		Enable the flying_car runtime module, its safety state machine, differential
		wheel mixing, and dedicated gated physical-motor output path.
```
